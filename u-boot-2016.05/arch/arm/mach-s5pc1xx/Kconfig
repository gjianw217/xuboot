## u-boot-2016.05/arch/arm/mach-s5pc1xx/Kconfig
```kconfig
if ARCH_S5PC1XX

choice
	prompt "S5PC1XX board select"
	optional

config TARGET_S5P_GONI
	bool "S5P Goni board"
	select OF_CONTROL

config TARGET_SMDKC100
	bool "Support smdkc100 board"
	select OF_CONTROL
	
config TARGET_SMDKV210
	bool "Support Samsung smdkv210"
	select SUPPORT_SPL
	select SPL
		help
		Support Samsung OK210platform based on Samsung s5pv210.
		
endchoice

config SYS_SOC
	default "s5pc1xx"

source "board/samsung/goni/Kconfig"
source "board/samsung/smdkc100/Kconfig"
source "board/samsung/smdkv210/Kconfig"

endif
```

## u-boot-2016.05/configs/smdkv210_defconfig
```kconfig
CONFIG_ARM=y
CONFIG_ARCH_S5PC1XX=y
CONFIG_TARGET_SMDKV210=y
CONFIG_DEFAULT_DEVICE_TREE="s5pv210-smdkv210"
CONFIG_HUSH_PARSER=y
CONFIG_SYS_PROMPT="SMDKV210 # "
# CONFIG_CMD_IMLS is not set
# CONFIG_CMD_FLASH is not set
# CONFIG_CMD_SETEXPR is not set
CONFIG_CMD_CACHE=y
CONFIG_CMD_FAT=y

CONFIG_OF_LIBFDT=y
CONFIG_OF_CONTROL=y
CONFIG_CMD_FDT=y
```
